/* generated by ASAP2 Studio 1.8.20.6233 */
/* A2L Version V05, SW version 05.52-04.01.00-01.00 */
/* @@@@ File written by CANAPE_VERSION 17 0 40 @@@@ */ ASAP2_VERSION 1 71
/begin PROJECT New ""
/begin MODULE New ""
/begin MOD_PAR "" /end MOD_PAR
/begin MOD_COMMON "" BYTE_ORDER MSB_LAST ALIGNMENT_BYTE 1 ALIGNMENT_WORD 2 ALIGNMENT_LONG 4 ALIGNMENT_FLOAT16_IEEE 1 ALIGNMENT_FLOAT32_IEEE 4 ALIGNMENT_FLOAT64_IEEE 8 ALIGNMENT_INT64 8 /end MOD_COMMON
/begin CHARACTERISTIC ACFG_as16_C_AngleHighway_ROM "" VALUE 0xDB6 __SWORD_S 0 Res_Div10 -3276.8 3276.7 /end CHARACTERISTIC
/begin CHARACTERISTIC ACFG_as16_C_Left_HL_LeftAngleMin_ROM "" VALUE 0xDC0 __SWORD_S 0 Res_Div10 -3276.8 3276.7 PHYS_UNIT "deg" /end CHARACTERISTIC
/begin CHARACTERISTIC ACFG_as16_C_Left_HL_RightAngleMax_ROM "" VALUE 0xDC2 __SWORD_S 0 Res_Div10 -3276.8 3276.7 PHYS_UNIT "deg" /end CHARACTERISTIC
/begin CHARACTERISTIC ACFG_as16_C_Right_HL_LeftAngleMin_ROM "" VALUE 0xDC4 __SWORD_S 0 Res_Div10 -3276.8 3276.7 PHYS_UNIT "deg" /end CHARACTERISTIC
/begin CHARACTERISTIC ACFG_as16_C_Right_HL_RightAngleMax_ROM "" VALUE 0xDC6 __SWORD_S 0 Res_Div10 -3276.8 3276.7 PHYS_UNIT "deg" /end CHARACTERISTIC
/begin CHARACTERISTIC C_BINCurrentTableDCDC10 "" CURVE 0x1C58C4 __UWORD_S 0 NO_COMPU_METHOD 0 2000
 /begin AXIS_DESCR FIX_AXIS NO_INPUT_QUANTITY NO_COMPU_METHOD 1 0 7 FIX_AXIS_PAR_DIST 0 1 8 FORMAT "%.15" /end AXIS_DESCR
 FORMAT "%.15" SYMBOL_LINK "C_BINCurrentTableDCDC10._0_" 0 /end CHARACTERISTIC
/begin CHARACTERISTIC C_BINCurrentTableDCDC11 "" CURVE 0x1C58D4 __UWORD_S 0 NO_COMPU_METHOD 0 2000
 /begin AXIS_DESCR FIX_AXIS NO_INPUT_QUANTITY NO_COMPU_METHOD 1 0 7 FIX_AXIS_PAR_DIST 0 1 8 FORMAT "%.15" /end AXIS_DESCR
 FORMAT "%.15" SYMBOL_LINK "C_BINCurrentTableDCDC11._0_" 0 /end CHARACTERISTIC
/begin CHARACTERISTIC C_B_DblEnableADW_PixelKink "This vector indicates if the DBL is enable on each module in each afs mode" CURVE 0x1C0D50 __UBYTE_S 0 NO_COMPU_METHOD 0 1
 /begin AXIS_DESCR FIX_AXIS NO_INPUT_QUANTITY NO_COMPU_METHOD 1 0 11 FIX_AXIS_PAR_DIST 0 1 12 FORMAT "%.15" /end AXIS_DESCR
 EXTENDED_LIMITS 0 255 FORMAT "%.15" PHYS_UNIT "bool" /end CHARACTERISTIC
/begin CHARACTERISTIC C_B_DblEnableCountry_HBSpot "This vector indicates if the DBL is enable on each module in each afs mode" CURVE 0x1C0D5C __UBYTE_S 0 NO_COMPU_METHOD 0 1
 /begin AXIS_DESCR FIX_AXIS NO_INPUT_QUANTITY NO_COMPU_METHOD 1 0 11 FIX_AXIS_PAR_DIST 0 1 12 FORMAT "%.15" /end AXIS_DESCR
 EXTENDED_LIMITS 0 255 FORMAT "%.15" PHYS_UNIT "bool" /end CHARACTERISTIC
/begin CHARACTERISTIC C_B_DblEnableCountry_Kink "This vector indicates if the DBL is enable on each module in each afs mode" CURVE 0x1C0D68 __UBYTE_S 0 NO_COMPU_METHOD 0 1
 /begin AXIS_DESCR FIX_AXIS NO_INPUT_QUANTITY NO_COMPU_METHOD 1 0 11 FIX_AXIS_PAR_DIST 0 1 12 FORMAT "%.15" /end AXIS_DESCR
 EXTENDED_LIMITS 0 255 FORMAT "%.15" PHYS_UNIT "bool" /end CHARACTERISTIC
/begin CHARACTERISTIC s32DefSmartCh3Ch4OverTemp "" VALUE 0xFEBD19A8 __SLONG_S 0 NO_COMPU_METHOD -2147483648 2147483647 FORMAT "%.15" /end CHARACTERISTIC
/begin CHARACTERISTIC s32DefSmartCh3Ch4VccOvervoltage "" VALUE 0xFEBD19B0 __SLONG_S 0 NO_COMPU_METHOD -2147483648 2147483647 FORMAT "%.15" /end CHARACTERISTIC
/begin CHARACTERISTIC s32DefSmartCh3Ch4VccUndervoltage "" VALUE 0xFEBD19B8 __SLONG_S 0 NO_COMPU_METHOD -2147483648 2147483647 FORMAT "%.15" /end CHARACTERISTIC
/begin COMPU_METHOD ASWM_enuSwitch5ActivationState.CONVERSION "enumeration table" TAB_VERB "%.0" "" COMPU_TAB_REF ASWM_enuSwitch5ActivationState.CONVERSION /end COMPU_METHOD
/begin COMPU_METHOD HalfStep_to_Fullstep "" FORM "%6.3" "" /begin FORMULA "x*2" /end FORMULA /end COMPU_METHOD
/begin COMPU_METHOD Res_Div10 "" FORM "%6.3" "" /begin FORMULA "x/10" /end FORMULA /end COMPU_METHOD
/begin COMPU_METHOD Res_Div100 "" FORM "%6.3" "" /begin FORMULA "x/100" /end FORMULA /end COMPU_METHOD
/begin COMPU_METHOD Res_Div1000 "" FORM "%6.3" "" /begin FORMULA "x/1000" /end FORMULA /end COMPU_METHOD
/begin COMPU_METHOD Res_Div200 "" FORM "%6.3" "" /begin FORMULA "x/200" /end FORMULA /end COMPU_METHOD
/begin COMPU_METHOD Res_Div50 "" FORM "%6.3" "" /begin FORMULA "x/50" /end FORMULA /end COMPU_METHOD
/begin COMPU_METHOD Res_Div5000 "" FORM "%6.3" "" /begin FORMULA "x/5000" /end FORMULA /end COMPU_METHOD
/begin COMPU_METHOD Res_Div64 "" FORM "%6.3" "" /begin FORMULA "x/64" /end FORMULA /end COMPU_METHOD
/begin COMPU_METHOD Table_1396 "" TAB_VERB "%6.3" "" COMPU_TAB_REF Table_1396 /end COMPU_METHOD
/begin COMPU_METHOD Table_1397 "" TAB_VERB "%6.3" "" COMPU_TAB_REF Table_1397 /end COMPU_METHOD
/begin COMPU_METHOD Table_1398 "" TAB_VERB "%6.3" "" COMPU_TAB_REF Table_1398 /end COMPU_METHOD
/begin COMPU_METHOD Table_558 "" TAB_VERB "%6.3" "" COMPU_TAB_REF Table_558 /end COMPU_METHOD
/begin COMPU_METHOD astrLedTpsMapping_FullLeds._0_.enuLedNB.CONVERSION "enumeration table" TAB_VERB "%.0" "" COMPU_TAB_REF astrLedTpsMapping_FullLeds._0_.enuLedNB.CONVERSION /end COMPU_METHOD
/begin COMPU_METHOD astrLedTpsMapping_FullLeds._0_.enuSwNB.CONVERSION "enumeration table" TAB_VERB "%.0" "" COMPU_TAB_REF astrLedTpsMapping_FullLeds._0_.enuSwNB.CONVERSION /end COMPU_METHOD
/begin COMPU_METHOD astrLedTpsMapping_FullLeds._0_.enuTpsID.CONVERSION "enumeration table" TAB_VERB "%.0" "" COMPU_TAB_REF astrLedTpsMapping_FullLeds._0_.enuTpsID.CONVERSION /end COMPU_METHOD
/begin COMPU_VTAB_RANGE ASWM_enuSwitch5ActivationState.CONVERSION "" 3 0 0 "ASWM_SwitchDeactivated" 1 1 "ASWM_SwitchActivated" 2 2 "ASWM_NB_SwitchActivationState" DEFAULT_VALUE "" /end COMPU_VTAB_RANGE
/begin COMPU_VTAB Table_1396 "" TAB_VERB 9 0 "AMXB_Tps_1" 1 "AMXB_Tps_2" 2 "AMXB_Tps_3" 3 "AMXB_Tps_4" 4 "AMXB_Tps_5" 5 "AMXB_Tps_6" 6 "AMXB_Tps_7" 7 "AMXB_Tps_8" 8 "AMXB_TPS_NUM" DEFAULT_VALUE "" /end COMPU_VTAB
/begin COMPU_VTAB Table_1397 "" TAB_VERB 96 -1 "AMXB_NO_LED" 0 "AMXB_LED_1" 1 "AMXB_LED_2" 2 "AMXB_LED_3" 3 "AMXB_LED_4" 4 "AMXB_LED_5" 5 "AMXB_LED_6" 6 "AMXB_LED_7" 7 "AMXB_LED_8" 8 "AMXB_LED_9" 9 "AMXB_LED_10" 10 "AMXB_LED_11" 11 "AMXB_LED_12" 12 "AMXB_LED_13" 13 "AMXB_LED_14" 14 "AMXB_LED_15" 15 "AMXB_LED_16" 16 "AMXB_LED_17" 17 "AMXB_LED_18" 18 "AMXB_LED_19" 19 "AMXB_LED_20" 20 "AMXB_LED_21" 21 "AMXB_LED_22" 22 "AMXB_LED_23" 23 "AMXB_LED_24" 24 "AMXB_LED_25" 25 "AMXB_LED_26" 26 "AMXB_LED_27" 27 "AMXB_LED_28" 28 "AMXB_LED_29" 29 "AMXB_LED_30" 30 "AMXB_LED_31" 31 "AMXB_LED_32" 32 "AMXB_LED_33" 33 "AMXB_LED_34" 34 "AMXB_LED_35" 35 "AMXB_LED_36" 36 "AMXB_LED_37" 37 "AMXB_LED_38" 38 "AMXB_LED_39" 39 "AMXB_LED_40" 40 "AMXB_LED_41" 41 "AMXB_LED_42" 42 "AMXB_LED_43" 43 "AMXB_LED_44" 44 "AMXB_LED_45" 45 "AMXB_LED_46" 46 "AMXB_LED_47" 47 "AMXB_LED_48" 48 "AMXB_LED_49" 49 "AMXB_LED_50" 50 "AMXB_LED_51" 51 "AMXB_LED_52" 52 "AMXB_LED_53" 53 "AMXB_LED_54" 54 "AMXB_LED_55" 55 "AMXB_LED_56" 56 "AMXB_LED_57" 57 "AMXB_LED_58" 58 "AMXB_LED_59" 59 "AMXB_LED_60" 60 "AMXB_LED_61" 61 "AMXB_LED_62" 62 "AMXB_LED_63" 63 "AMXB_LED_64" 64 "AMXB_LED_65" 65 "AMXB_LED_66" 66 "AMXB_LED_67" 67 "AMXB_LED_68" 68 "AMXB_LED_69" 69 "AMXB_LED_70" 70 "AMXB_LED_71" 71 "AMXB_LED_72" 72 "AMXB_LED_73" 73 "AMXB_LED_74" 74 "AMXB_LED_75" 75 "AMXB_LED_76" 76 "AMXB_LED_77" 77 "AMXB_LED_78" 78 "AMXB_LED_79" 79 "AMXB_LED_80" 80 "AMXB_LED_81" 81 "AMXB_LED_82" 82 "AMXB_LED_83" 83 "AMXB_LED_84" 84 "AMXB_LED_85" 85 "AMXB_LED_86" 86 "AMXB_LED_87" 87 "AMXB_LED_88" 88 "AMXB_LED_89" 89 "AMXB_LED_90" 90 "AMXB_LED_91" 91 "AMXB_LED_92" 92 "AMXB_LED_93" 93 "AMXB_LED_94" 94 "AMXB_LED_95" DEFAULT_VALUE "" /end COMPU_VTAB
/begin COMPU_VTAB Table_1398 "" TAB_VERB 13 -1 "AMXB_NO_SW" 0 "AMXB_SW_1" 1 "AMXB_SW_2" 2 "AMXB_SW_3" 3 "AMXB_SW_4" 4 "AMXB_SW_5" 5 "AMXB_SW_6" 6 "AMXB_SW_7" 7 "AMXB_SW_8" 8 "AMXB_SW_9" 9 "AMXB_SW_10" 10 "AMXB_SW_11" 11 "AMXB_SW_12" DEFAULT_VALUE "" /end COMPU_VTAB
/begin COMPU_VTAB Table_558 "" TAB_VERB 3 0 "ASWM_SwitchDeactivated" 1 "ASWM_SwitchActivated" 2 "ASWM_NB_SwitchActivationState" DEFAULT_VALUE "" /end COMPU_VTAB
/begin COMPU_VTAB_RANGE astrLedTpsMapping_FullLeds._0_.enuLedNB.CONVERSION "" 96 -1 -1 "AMXB_NO_LED" 0 0 "AMXB_LED_1" 1 1 "AMXB_LED_2" 2 2 "AMXB_LED_3" 3 3 "AMXB_LED_4" 4 4 "AMXB_LED_5" 5 5 "AMXB_LED_6" 6 6 "AMXB_LED_7" 7 7 "AMXB_LED_8" 8 8 "AMXB_LED_9" 9 9 "AMXB_LED_10" 10 10 "AMXB_LED_11" 11 11 "AMXB_LED_12" 12 12 "AMXB_LED_13" 13 13 "AMXB_LED_14" 14 14 "AMXB_LED_15" 15 15 "AMXB_LED_16" 16 16 "AMXB_LED_17" 17 17 "AMXB_LED_18" 18 18 "AMXB_LED_19" 19 19 "AMXB_LED_20" 20 20 "AMXB_LED_21" 21 21 "AMXB_LED_22" 22 22 "AMXB_LED_23" 23 23 "AMXB_LED_24" 24 24 "AMXB_LED_25" 25 25 "AMXB_LED_26" 26 26 "AMXB_LED_27" 27 27 "AMXB_LED_28" 28 28 "AMXB_LED_29" 29 29 "AMXB_LED_30" 30 30 "AMXB_LED_31" 31 31 "AMXB_LED_32" 32 32 "AMXB_LED_33" 33 33 "AMXB_LED_34" 34 34 "AMXB_LED_35" 35 35 "AMXB_LED_36" 36 36 "AMXB_LED_37" 37 37 "AMXB_LED_38" 38 38 "AMXB_LED_39" 39 39 "AMXB_LED_40" 40 40 "AMXB_LED_41" 41 41 "AMXB_LED_42" 42 42 "AMXB_LED_43" 43 43 "AMXB_LED_44" 44 44 "AMXB_LED_45" 45 45 "AMXB_LED_46" 46 46 "AMXB_LED_47" 47 47 "AMXB_LED_48" 48 48 "AMXB_LED_49" 49 49 "AMXB_LED_50" 50 50 "AMXB_LED_51" 51 51 "AMXB_LED_52" 52 52 "AMXB_LED_53" 53 53 "AMXB_LED_54" 54 54 "AMXB_LED_55" 55 55 "AMXB_LED_56" 56 56 "AMXB_LED_57" 57 57 "AMXB_LED_58" 58 58 "AMXB_LED_59" 59 59 "AMXB_LED_60" 60 60 "AMXB_LED_61" 61 61 "AMXB_LED_62" 62 62 "AMXB_LED_63" 63 63 "AMXB_LED_64" 64 64 "AMXB_LED_65" 65 65 "AMXB_LED_66" 66 66 "AMXB_LED_67" 67 67 "AMXB_LED_68" 68 68 "AMXB_LED_69" 69 69 "AMXB_LED_70" 70 70 "AMXB_LED_71" 71 71 "AMXB_LED_72" 72 72 "AMXB_LED_73" 73 73 "AMXB_LED_74" 74 74 "AMXB_LED_75" 75 75 "AMXB_LED_76" 76 76 "AMXB_LED_77" 77 77 "AMXB_LED_78" 78 78 "AMXB_LED_79" 79 79 "AMXB_LED_80" 80 80 "AMXB_LED_81" 81 81 "AMXB_LED_82" 82 82 "AMXB_LED_83" 83 83 "AMXB_LED_84" 84 84 "AMXB_LED_85" 85 85 "AMXB_LED_86" 86 86 "AMXB_LED_87" 87 87 "AMXB_LED_88" 88 88 "AMXB_LED_89" 89 89 "AMXB_LED_90" 90 90 "AMXB_LED_91" 91 91 "AMXB_LED_92" 92 92 "AMXB_LED_93" 93 93 "AMXB_LED_94" 94 94 "AMXB_LED_95" DEFAULT_VALUE "" /end COMPU_VTAB_RANGE
/begin COMPU_VTAB_RANGE astrLedTpsMapping_FullLeds._0_.enuSwNB.CONVERSION "" 13 -1 -1 "AMXB_NO_SW" 0 0 "AMXB_SW_1" 1 1 "AMXB_SW_2" 2 2 "AMXB_SW_3" 3 3 "AMXB_SW_4" 4 4 "AMXB_SW_5" 5 5 "AMXB_SW_6" 6 6 "AMXB_SW_7" 7 7 "AMXB_SW_8" 8 8 "AMXB_SW_9" 9 9 "AMXB_SW_10" 10 10 "AMXB_SW_11" 11 11 "AMXB_SW_12" DEFAULT_VALUE "" /end COMPU_VTAB_RANGE
/begin COMPU_VTAB_RANGE astrLedTpsMapping_FullLeds._0_.enuTpsID.CONVERSION "" 9 0 0 "AMXB_Tps_1" 1 1 "AMXB_Tps_2" 2 2 "AMXB_Tps_3" 3 3 "AMXB_Tps_4" 4 4 "AMXB_Tps_5" 5 5 "AMXB_Tps_6" 6 6 "AMXB_Tps_7" 7 7 "AMXB_Tps_8" 8 8 "AMXB_TPS_NUM" DEFAULT_VALUE "" /end COMPU_VTAB_RANGE
/begin RECORD_LAYOUT SSV__A_INT64_S AXIS_PTS_X 1 A_INT64 INDEX_INCR DIRECT /end RECORD_LAYOUT
/begin RECORD_LAYOUT SSV__A_UINT64_S AXIS_PTS_X 1 A_UINT64 INDEX_INCR DIRECT /end RECORD_LAYOUT
/begin RECORD_LAYOUT SSV__FLOAT32_IEEE_S AXIS_PTS_X 1 FLOAT32_IEEE INDEX_INCR DIRECT /end RECORD_LAYOUT
/begin RECORD_LAYOUT SSV__FLOAT64_IEEE_S AXIS_PTS_X 1 FLOAT64_IEEE INDEX_INCR DIRECT /end RECORD_LAYOUT
/begin RECORD_LAYOUT SSV__SBYTE_S AXIS_PTS_X 1 SBYTE INDEX_INCR DIRECT /end RECORD_LAYOUT
/begin RECORD_LAYOUT SSV__SLONG_S AXIS_PTS_X 1 SLONG INDEX_INCR DIRECT /end RECORD_LAYOUT
/begin RECORD_LAYOUT SSV__SWORD_S AXIS_PTS_X 1 SWORD INDEX_INCR DIRECT /end RECORD_LAYOUT
/begin RECORD_LAYOUT SSV__UBYTE_S AXIS_PTS_X 1 UBYTE INDEX_INCR DIRECT /end RECORD_LAYOUT
/begin RECORD_LAYOUT SSV__ULONG_S AXIS_PTS_X 1 ULONG INDEX_INCR DIRECT /end RECORD_LAYOUT
/begin RECORD_LAYOUT SSV__UWORD_S AXIS_PTS_X 1 UWORD INDEX_INCR DIRECT /end RECORD_LAYOUT
/begin RECORD_LAYOUT __A_INT64_S FNC_VALUES 1 A_INT64 COLUMN_DIR DIRECT /end RECORD_LAYOUT
/begin RECORD_LAYOUT __A_INT64_Z FNC_VALUES 1 A_INT64 ROW_DIR DIRECT /end RECORD_LAYOUT
/begin RECORD_LAYOUT __A_UINT64_S FNC_VALUES 1 A_UINT64 COLUMN_DIR DIRECT /end RECORD_LAYOUT
/begin RECORD_LAYOUT __A_UINT64_Z FNC_VALUES 1 A_UINT64 ROW_DIR DIRECT /end RECORD_LAYOUT
/begin RECORD_LAYOUT __FLOAT32_IEEE_S FNC_VALUES 1 FLOAT32_IEEE COLUMN_DIR DIRECT /end RECORD_LAYOUT
/begin RECORD_LAYOUT __FLOAT32_IEEE_Z FNC_VALUES 1 FLOAT32_IEEE ROW_DIR DIRECT /end RECORD_LAYOUT
/begin RECORD_LAYOUT __FLOAT64_IEEE_S FNC_VALUES 1 FLOAT64_IEEE COLUMN_DIR DIRECT /end RECORD_LAYOUT
/begin RECORD_LAYOUT __FLOAT64_IEEE_Z FNC_VALUES 1 FLOAT64_IEEE ROW_DIR DIRECT /end RECORD_LAYOUT
/begin RECORD_LAYOUT __SBYTE_S FNC_VALUES 1 SBYTE COLUMN_DIR DIRECT /end RECORD_LAYOUT
/begin RECORD_LAYOUT __SBYTE_Z FNC_VALUES 1 SBYTE ROW_DIR DIRECT /end RECORD_LAYOUT
/begin RECORD_LAYOUT __SLONG_S FNC_VALUES 1 SLONG COLUMN_DIR DIRECT /end RECORD_LAYOUT
/begin RECORD_LAYOUT __SLONG_Z FNC_VALUES 1 SLONG ROW_DIR DIRECT /end RECORD_LAYOUT
/begin RECORD_LAYOUT __SWORD_S FNC_VALUES 1 SWORD COLUMN_DIR DIRECT /end RECORD_LAYOUT
/begin RECORD_LAYOUT __SWORD_Z FNC_VALUES 1 SWORD ROW_DIR DIRECT /end RECORD_LAYOUT
/begin RECORD_LAYOUT __UBYTE_S FNC_VALUES 1 UBYTE COLUMN_DIR DIRECT /end RECORD_LAYOUT
/begin RECORD_LAYOUT __UBYTE_Z FNC_VALUES 1 UBYTE ROW_DIR DIRECT /end RECORD_LAYOUT
/begin RECORD_LAYOUT __ULONG_S FNC_VALUES 1 ULONG COLUMN_DIR DIRECT /end RECORD_LAYOUT
/begin RECORD_LAYOUT __ULONG_Z FNC_VALUES 1 ULONG ROW_DIR DIRECT /end RECORD_LAYOUT
/begin RECORD_LAYOUT __UWORD_S FNC_VALUES 1 UWORD COLUMN_DIR DIRECT /end RECORD_LAYOUT
/begin RECORD_LAYOUT __UWORD_Z FNC_VALUES 1 UWORD ROW_DIR DIRECT /end RECORD_LAYOUT
/begin GROUP ABD_Slave "" ROOT
 /begin REF_CHARACTERISTIC CC_pwm_type_zero CIECurveGammaToPwmEvenX CIECurveGammaToPwmY CIECurvePwmToGammaEvenX CIECurvePwmToGammaY C_AngleHighway C_B_ActivateAdb2D C_B_AreLightingModesAutorizedInPower2 C_B_DblEnableCountry_LB C_B_EnableTwoDReactivationAdb C_B_EnableTwoDReactivationCurtain C_B_EnableTwoDReactivationMotorway C_B_FadingDisable C_B_IsADWModeAutorizedInPower2 C_B_IsDRLAutorizedInPower2 C_B_IsFactoryModeAutorizedInPower2 C_B_IsFoggyModeAutorizedInPower2 C_B_IsHB_HSModeAutorizedInPower2 C_B_IsHB_LSModeAutorizedInPower2 C_B_IsMWModeAutorizedInPower2 C_B_IsManoeuverModeAutorizedInPower2 C_B_IsPLAutorizedInPower2 C_B_IsPedesModeAutorizedInPower2 C_B_IsTIAutorizedInPower2 C_B_IsTouristModeAutorizedInPower2 C_B_IsTownModeAutorizedInPower2 C_B_LedImpactedByF2P C_B_MaskAdbPixel C_B_OpticalModuleFAN1Rqst C_B_OpticalModuleFAN2Rqst C_B_OpticalModuleFAN3Rqst C_B_OpticalModuleFAN4Rqst C_B_OpticalModuleFAN5Rqst C_B_SlidingTiStepOfTheLeds C_CurtainCloseEnable C_CurtainCloseSpeed C_CurtainOpenEnable C_CurtainOpenSpeed C_DynamicHighwayAngleActivation C_E_OpticalModuleOfEachLed C_F_AngCam2Proj C_F_AngOffsetLeft C_F_AngOffsetRight C_F_BlurSizeGFHB C_F_DrlRampTime C_F_FadingDisableSlidingTI C_F_HysterisisOnLedEdgeGFHB C_F_HysterisisOnLedEdge_Motorway C_F_IsOpticalModuleADCDC C_F_LedBotLimits C_F_LedCenterLimits C_F_LedLeftLimits C_F_LedRightLimits C_F_ModuleRampTimeInADW C_F_ModuleRampTimeInCountry C_F_ModuleRampTimeInFoggy C_F_ModuleRampTimeInHB_HS C_F_ModuleRampTimeInHB_LS C_F_ModuleRampTimeInMTW C_F_ModuleRampTimeInManeuv C_F_ModuleRampTimeInPedes C_F_ModuleRampTimeInTourist C_F_ModuleRampTimeInTown C_F_OpticalModule_PLNominalPWM C_F_PerLightDistribADWAt0_HBSpot C_F_PerLightDistribADWAt0_Kink C_F_PerLightDistribADWAt0_LB C_F_PerLightDistribADWAt0_PixelHB C_F_PerLightDistribADWAt0_PixelKink C_F_PerLightDistribADWAtLeft_HBSpot C_F_PerLightDistribADWAtLeft_Kink C_F_PerLightDistribADWAtLeft_LB C_F_PerLightDistribADWAtLeft_PixelHB C_F_PerLightDistribADWAtLeft_PixelKink C_F_PerLightDistribADWAtRight_HBSpot C_F_PerLightDistribADWAtRight_Kink C_F_PerLightDistribADWAtRight_LB C_F_PerLightDistribADWAtRight_PixelHB C_F_PerLightDistribADWAtRight_PixelKink C_F_PerLightDistribCountryAt0_HBSpot C_F_PerLightDistribCountryAt0_Kink C_F_PerLightDistribCountryAt0_LB C_F_PerLightDistribCountryAt0_PixelHB C_F_PerLightDistribCountryAt0_PixelKink C_F_PerLightDistribCountryAtLeft_HBSpot C_F_PerLightDistribCountryAtLeft_Kink C_F_PerLightDistribCountryAtLeft_LB C_F_PerLightDistribCountryAtLeft_PixelHB C_F_PerLightDistribCountryAtLeft_PixelKink C_F_PerLightDistribCountryAtRight_HBSpot C_F_PerLightDistribCountryAtRight_Kink C_F_PerLightDistribCountryAtRight_LB C_F_PerLightDistribCountryAtRight_PixelHB C_F_PerLightDistribCountryAtRight_PixelKink C_F_PerLightDistribFTP C_F_PerLightDistribFoggyAt0_HBSpot C_F_PerLightDistribFoggyAt0_Kink C_F_PerLightDistribFoggyAt0_LB C_F_PerLightDistribFoggyAt0_PixelHB C_F_PerLightDistribFoggyAt0_PixelKink C_F_PerLightDistribFoggyAtLeft_HBSpot C_F_PerLightDistribFoggyAtLeft_Kink C_F_PerLightDistribFoggyAtLeft_LB C_F_PerLightDistribFoggyAtLeft_PixelHB C_F_PerLightDistribFoggyAtLeft_PixelKink C_F_PerLightDistribFoggyAtRight_HBSpot C_F_PerLightDistribFoggyAtRight_Kink C_F_PerLightDistribFoggyAtRight_LB C_F_PerLightDistribFoggyAtRight_PixelHB C_F_PerLightDistribFoggyAtRight_PixelKink C_F_PerLightDistribHB_HSAt0_HBSpot C_F_PerLightDistribHB_HSAt0_Kink C_F_PerLightDistribHB_HSAt0_LB C_F_PerLightDistribHB_HSAt0_PixelHB C_F_PerLightDistribHB_HSAt0_PixelKink C_F_PerLightDistribHB_HSAtLeft_HBSpot C_F_PerLightDistribHB_HSAtLeft_Kink C_F_PerLightDistribHB_HSAtLeft_LB C_F_PerLightDistribHB_HSAtLeft_PixelHB C_F_PerLightDistribHB_HSAtLeft_PixelKink C_F_PerLightDistribHB_HSAtRight_HBSpot C_F_PerLightDistribHB_HSAtRight_Kink C_F_PerLightDistribHB_HSAtRight_LB C_F_PerLightDistribHB_HSAtRight_PixelHB C_F_PerLightDistribHB_HSAtRight_PixelKink C_F_PerLightDistribHB_LSAt0_HBSpot C_F_PerLightDistribHB_LSAt0_Kink C_F_PerLightDistribHB_LSAt0_LB C_F_PerLightDistribHB_LSAt0_PixelHB C_F_PerLightDistribHB_LSAt0_PixelKink C_F_PerLightDistribHB_LSAtLeft_HBSpot C_F_PerLightDistribHB_LSAtLeft_Kink C_F_PerLightDistribHB_LSAtLeft_LB C_F_PerLightDistribHB_LSAtLeft_PixelHB C_F_PerLightDistribHB_LSAtLeft_PixelKink C_F_PerLightDistribHB_LSAtRight_HBSpot C_F_PerLightDistribHB_LSAtRight_Kink C_F_PerLightDistribHB_LSAtRight_LB C_F_PerLightDistribHB_LSAtRight_PixelHB C_F_PerLightDistribHB_LSAtRight_PixelKink C_F_PerLightDistribMTWAt0_HBSpot C_F_PerLightDistribMTWAt0_Kink C_F_PerLightDistribMTWAt0_LB C_F_PerLightDistribMTWAt0_PixelHB C_F_PerLightDistribMTWAt0_PixelKink C_F_PerLightDistribMTWAtLeft_HBSpot C_F_PerLightDistribMTWAtLeft_Kink C_F_PerLightDistribMTWAtLeft_LB C_F_PerLightDistribMTWAtLeft_PixelHB C_F_PerLightDistribMTWAtLeft_PixelKink C_F_PerLightDistribMTWAtRight_HBSpot C_F_PerLightDistribMTWAtRight_Kink C_F_PerLightDistribMTWAtRight_LB C_F_PerLightDistribMTWAtRight_PixelHB C_F_PerLightDistribMTWAtRight_PixelKink C_F_PerLightDistribManeuvAt0_HBSpot C_F_PerLightDistribManeuvAt0_Kink C_F_PerLightDistribManeuvAt0_LB C_F_PerLightDistribManeuvAt0_PixelHB C_F_PerLightDistribManeuvAt0_PixelKink C_F_PerLightDistribManeuvAtLeft_HBSpot C_F_PerLightDistribManeuvAtLeft_Kink C_F_PerLightDistribManeuvAtLeft_LB C_F_PerLightDistribManeuvAtLeft_PixelHB C_F_PerLightDistribManeuvAtLeft_PixelKink C_F_PerLightDistribManeuvAtRight_HBSpot C_F_PerLightDistribManeuvAtRight_Kink C_F_PerLightDistribManeuvAtRight_LB C_F_PerLightDistribManeuvAtRight_PixelHB C_F_PerLightDistribManeuvAtRight_PixelKink C_F_PerLightDistribPedesAt0_HBSpot C_F_PerLightDistribPedesAt0_Kink C_F_PerLightDistribPedesAt0_LB C_F_PerLightDistribPedesAt0_PixelHB C_F_PerLightDistribPedesAt0_PixelKink C_F_PerLightDistribPedesAtLeft_HBSpot C_F_PerLightDistribPedesAtLeft_Kink C_F_PerLightDistribPedesAtLeft_LB C_F_PerLightDistribPedesAtLeft_PixelHB C_F_PerLightDistribPedesAtLeft_PixelKink C_F_PerLightDistribPedesAtRight_HBSpot C_F_PerLightDistribPedesAtRight_Kink C_F_PerLightDistribPedesAtRight_LB C_F_PerLightDistribPedesAtRight_PixelHB C_F_PerLightDistribPedesAtRight_PixelKink C_F_PerLightDistribTouristAt0_HBSpot C_F_PerLightDistribTouristAt0_Kink C_F_PerLightDistribTouristAt0_LB C_F_PerLightDistribTouristAt0_PixelHB C_F_PerLightDistribTouristAt0_PixelKink C_F_PerLightDistribTouristAtLeft_HBSpot C_F_PerLightDistribTouristAtLeft_Kink C_F_PerLightDistribTouristAtLeft_LB C_F_PerLightDistribTouristAtLeft_PixelHB C_F_PerLightDistribTouristAtLeft_PixelKink C_F_PerLightDistribTouristAtRight_HBSpot C_F_PerLightDistribTouristAtRight_Kink C_F_PerLightDistribTouristAtRight_LB C_F_PerLightDistribTouristAtRight_PixelHB C_F_PerLightDistribTouristAtRight_PixelKink C_F_PerLightDistribTownAt0_HBSpot C_F_PerLightDistribTownAt0_Kink C_F_PerLightDistribTownAt0_LB C_F_PerLightDistribTownAt0_PixelHB C_F_PerLightDistribTownAt0_PixelKink C_F_PerLightDistribTownAtLeft_HBSpot C_F_PerLightDistribTownAtLeft_Kink C_F_PerLightDistribTownAtLeft_LB C_F_PerLightDistribTownAtLeft_PixelHB C_F_PerLightDistribTownAtLeft_PixelKink C_F_PerLightDistribTownAtRight_HBSpot C_F_PerLightDistribTownAtRight_Kink C_F_PerLightDistribTownAtRight_LB C_F_PerLightDistribTownAtRight_PixelHB C_F_PerLightDistribTownAtRight_PixelKink C_F_RampTimeSlidingTI C_F_ReactivationDelayADB C_F_SignalingConfGrp1 C_F_SignalingConfGrp2 C_F_SignalingModuleGroup C_F_SingleLEDToDCDCmap C_F_Speed_OFF C_F_Speed_ON C_F_TeSignaling C_F_Te_ADBS C_F_TickTIBlck C_F_TwoDReactivationDelayAdbLUT_TimeVsBotAng_Xvalues C_F_TwoDReactivationDelayAdbLUT_TimeVsBotAng_Yvalues C_F_TwoDReactivationDelayCurtainLUT_TimeVsBotAng_Xvalues C_F_TwoDReactivationDelayCurtainLUT_TimeVsBotAng_Yvalues C_F_TwoDReactivationDelayMotorwayLUT_TimeVsBotAng_Xvalues C_F_TwoDReactivationDelayMotorwayLUT_TimeVsBotAng_Yvalues C_F_TypeOpticalModule C_F_opt_TI_Trace C_HighwayCloseEnable C_HighwayCloseSpeed C_HighwayCurveRadiusOffset_XValuesDriverSide C_HighwayCurveRadiusOffset_XValuesPassengerSide C_HighwayCurveRadiusOffset_YValuesDriverSide C_HighwayCurveRadiusOffset_YValuesPassengerSide C_HighwayOpenEnable C_HighwayOpenSpeed C_HighwayShadowEnable C_Left_HL_LeftAngleMin C_Left_HL_RightAngleMax C_RampDownTimeCurtain C_RampDownTimeHighway C_RampUpTimeCurtain C_RampUpTimeHighway C_Right_HL_LeftAngleMin C_Right_HL_RightAngleMax IsCurtainShadow IsCurtainShadow_first_idx IsGfhbShadow IsHighwayShadow IsHighwayShadow_first_idx P_AnimationPeriod P_DefaultValue P_MaintainAnimation /end REF_CHARACTERISTIC
/end GROUP
/begin GROUP ADB_Master "" ROOT
 /begin REF_CHARACTERISTIC C_B_MBMS_Enable C_B_MBMS_Speed C_B_PSAC_Enable C_F_AngAreaMultiRelight C_F_AngCenterLimitLeft C_F_AngCenterLimitRight C_F_AngMaxLeftLed C_F_AngMaxRightLed C_F_AngleOffsetOvertaking C_F_ClusterLowIntensityADB C_F_DistMultipleOnComingtraffic C_F_DistOvertakingDetection C_F_DistXCamProjL C_F_DistXCamProjR C_F_DistYCamProj C_F_DistanceOffsetMaxDistance C_F_DistanceOffsetMaxValue C_F_DistanceOffsetMinDistance C_F_Left_HL_LeftAngleMin C_F_Left_HL_RightAngleMax C_F_ObjectMinimalWidth C_F_ObjectPersistenceGFHB C_F_PSAC_SpeedToCenter C_F_PSAC_SpeedToSides C_F_RampDownTimeADB C_F_RampUpTimeADB C_F_Right_HL_LeftAngleMin C_F_Right_HL_RightAngleMax C_F_StaticOffset C_F_Te /end REF_CHARACTERISTIC
/end GROUP
/begin GROUP CAN_Management "" ROOT /begin REF_CHARACTERISTIC ACFG_ku8CanAppliVerify_ROM /end REF_CHARACTERISTIC /end GROUP
/begin GROUP CAN_UART "" ROOT /begin REF_CHARACTERISTIC ACFG_ku8DigNumberLeds_ROM ACFG_ku8DigNumberTPS_ROM /end REF_CHARACTERISTIC
 /begin SUB_GROUP ChipConfigurationChip_VAR1 DefaultWidtch HTPS_au8MainModeManagmentScheduler PAR_DigPhaseSwitch_X_TPS_Y PAR_InitialDutyCycle astrLedTpsMapping_FullLeds /end SUB_GROUP
/end GROUP
/begin GROUP C_DrvDeratingStep "driver thermal derating steps" /begin REF_CHARACTERISTIC ku16PwrDrvDeratingStep /end REF_CHARACTERISTIC /end GROUP
/begin GROUP C_DrvHystresis "Hysteresys for driver thermal derating local" /begin REF_CHARACTERISTIC ks16PwrDrvHystresis /end REF_CHARACTERISTIC /end GROUP
/begin GROUP C_DrvNominalPWM "nominal value for power derating (100% normally)" /begin REF_CHARACTERISTIC ku16PwrDrvNominalPWM /end REF_CHARACTERISTIC /end GROUP
/begin GROUP C_DrvPWMMins "minimum value for Powr derating" /begin REF_CHARACTERISTIC ku16PwrDrvPWMMins /end REF_CHARACTERISTIC /end GROUP
/begin GROUP C_DrvTemp_Threshold "Threshold value for Local driver thermal deratings" /begin REF_CHARACTERISTIC ks16PwrDrvTemThreshold /end REF_CHARACTERISTIC /end GROUP
/begin GROUP C_GeneralDrvTemp_Threshold "Threshold value for general driver thermal deratings" /begin REF_CHARACTERISTIC ks16PwrGeneralDrvTemThreshold /end REF_CHARACTERISTIC /end GROUP
/begin GROUP ChipConfigurationChip_VAR1 ""
 /begin REF_CHARACTERISTIC astrChipConfigurationChip_VAR1._0_.au8TpsPhysicalAddress astrChipConfigurationChip_VAR1._0_.u8TpsChipActive astrChipConfigurationChip_VAR1._1_.au8TpsPhysicalAddress astrChipConfigurationChip_VAR1._1_.u8TpsChipActive astrChipConfigurationChip_VAR1._2_.au8TpsPhysicalAddress astrChipConfigurationChip_VAR1._2_.u8TpsChipActive astrChipConfigurationChip_VAR1._3_.au8TpsPhysicalAddress astrChipConfigurationChip_VAR1._3_.u8TpsChipActive astrChipConfigurationChip_VAR1._4_.au8TpsPhysicalAddress astrChipConfigurationChip_VAR1._4_.u8TpsChipActive astrChipConfigurationChip_VAR1._5_.au8TpsPhysicalAddress astrChipConfigurationChip_VAR1._5_.u8TpsChipActive astrChipConfigurationChip_VAR1._6_.au8TpsPhysicalAddress astrChipConfigurationChip_VAR1._6_.u8TpsChipActive astrChipConfigurationChip_VAR1._7_.au8TpsPhysicalAddress astrChipConfigurationChip_VAR1._7_.u8TpsChipActive /end REF_CHARACTERISTIC
/end GROUP
/begin GROUP CurrentRegulation "" ROOT
 /begin REF_CHARACTERISTIC PAR_CurDef PAR_EnumLedoutType PAR_FreqLed PAR_LEDOutputNeeded /end REF_CHARACTERISTIC
/end GROUP
/begin GROUP DefaultWidtch "This parameter is the value of the default PWM width to apply on the switch X of the TPS Y.  0 means that when the watchdog timed out, the LED connected\\n to the switch X is off all the time and 1023 means thatwhen the watchdog timed out the LED connected to the switch X is on all the time.\\nX is an integer from 1 to 12\\nY is an integer from 1 to PAR_DigNumberTPS" /begin REF_CHARACTERISTIC au16DefWidtch /end REF_CHARACTERISTIC /end GROUP
/begin GROUP HTPS_au8MainModeManagmentScheduler "HTPS scheduler management in the Read Cycle" /begin REF_CHARACTERISTIC HTPS_au8MainModeManagmentScheduler /end REF_CHARACTERISTIC /end GROUP
/begin GROUP LR_Config "" ROOT
 /begin REF_CHARACTERISTIC ACFG_ku8SdmGroundSide_ROM ACFG_ku8SdmOCSide_ROM ACFG_ku8SdmVbatt_Side_ROM /end REF_CHARACTERISTIC
/end GROUP
/begin GROUP LVL_Slave "" ROOT
 /begin REF_CHARACTERISTIC PAR_BoolEnableSlaveMechanicalLVL PAR_ConfigSafety PAR_LVL_Ihold PAR_LVL_Irun PAR_LVL_Irun_cold PAR_Lvl_FailPos PAR_Lvl_FailSpeed PAR_Lvl_Gain PAR_Lvl_NomPos PAR_Lvl_Range PAR_Lvl_Ref_N2 PAR_Lvl_Ref_V1 PAR_Lvl_Ref_V2 PAR_Lvl_Shaft PAR_Lvl_Slow PAR_Lvl_Speed PAR_Lvl_Tdir PAR_Lvl_Tstab PAR_Lvl_Tstart PAR_Max_Lvl_Pos PAR_Min_Lvl_Pos PAR_Threshold_LVL_Steploss /end REF_CHARACTERISTIC
/end GROUP
/begin GROUP MF4_Power_Control_1 "" ROOT
 /begin REF_CHARACTERISTIC ACFG_ku16PwrBavDecreaseSmooth_ROM ACFG_ku16PwrDCDCDefaultVltVal_ROM ACFG_ku16PwrMaxCurrentAuxSupply_ROM ACFG_ku16PwrMaxCurrentKL30_ROM ACFG_ku16PwrPowerDeratingHyst_ROM ACFG_ku16PwrPwrNeededInit_ROM ACFG_ku16PwrVheadRoom_ROM ACFG_ku8PwrBavVmax_ROM ACFG_ku8PwrBavVmin_ROM ACFG_ku8PwrDigPderatingDecGain_ROM ACFG_ku8PwrDigPderatingFilterAvailCoeff_ROM ACFG_ku8PwrDigPderatingFilterNeedsCoeff_ROM ACFG_ku8PwrDigPderatingIncGain_ROM ACFG_ku8PwrNbrTickMaxVoltage_ROM CIECurveGammaToPwmY C_BINCurrentTableDCDC1 C_BINCurrentTableDCDC10 C_BINCurrentTableDCDC11 C_BINCurrentTableDCDC12 C_BINCurrentTableDCDC2 C_BINCurrentTableDCDC3 C_BINCurrentTableDCDC4 C_BINCurrentTableDCDC5 C_BINCurrentTableDCDC6 C_BINCurrentTableDCDC7 C_BINCurrentTableDCDC8 C_BINCurrentTableDCDC9 C_BINDcyTableDCDC1 C_B_OpticalModuleAnimPriorityOverFunctionnal C_B_OpticalModuleImpactedByAnim C_DrvDeratingStep C_DrvHystresis C_DrvNominalPWM C_DrvPWMMins C_DrvTemp_Threshold C_F_DblLeftAndRightEdgesADW_HBSpot C_F_DblLeftAndRightEdgesADW_Kink C_F_DblLeftAndRightEdgesADW_LB C_F_DblLeftAndRightEdgesADW_PixelHB C_F_DblLeftAndRightEdgesADW_PixelKink C_F_DblLeftAndRightEdgesCountry_HBSpot C_F_DblLeftAndRightEdgesCountry_Kink C_F_DblLeftAndRightEdgesCountry_LB C_F_DblLeftAndRightEdgesCountry_PixelHB C_F_DblLeftAndRightEdgesCountry_PixelKink C_F_DblLeftAndRightEdgesFoggy_HBSpot C_F_DblLeftAndRightEdgesFoggy_Kink C_F_DblLeftAndRightEdgesFoggy_LB C_F_DblLeftAndRightEdgesFoggy_PixelHB C_F_DblLeftAndRightEdgesFoggy_PixelKink C_F_DblLeftAndRightEdgesHB_HS_HBSpot C_F_DblLeftAndRightEdgesHB_HS_Kink C_F_DblLeftAndRightEdgesHB_HS_LB C_F_DblLeftAndRightEdgesHB_HS_PixelHB C_F_DblLeftAndRightEdgesHB_HS_PixelKink C_F_DblLeftAndRightEdgesHB_LS_HBSpot C_F_DblLeftAndRightEdgesHB_LS_Kink C_F_DblLeftAndRightEdgesHB_LS_LB C_F_DblLeftAndRightEdgesHB_LS_PixelHB C_F_DblLeftAndRightEdgesHB_LS_PixelKink C_F_DblLeftAndRightEdgesMTW_HBSpot C_F_DblLeftAndRightEdgesMTW_Kink C_F_DblLeftAndRightEdgesMTW_LB C_F_DblLeftAndRightEdgesMTW_PixelHB C_F_DblLeftAndRightEdgesMTW_PixelKink C_F_DblLeftAndRightEdgesManeuv_HBSpot C_F_DblLeftAndRightEdgesManeuv_Kink C_F_DblLeftAndRightEdgesManeuv_LB C_F_DblLeftAndRightEdgesManeuv_PixelHB C_F_DblLeftAndRightEdgesManeuv_PixelKink C_F_DblLeftAndRightEdgesPedes_HBSpot C_F_DblLeftAndRightEdgesPedes_Kink C_F_DblLeftAndRightEdgesPedes_LB C_F_DblLeftAndRightEdgesPedes_PixelHB C_F_DblLeftAndRightEdgesPedes_PixelKink C_F_DblLeftAndRightEdgesTourist_HBSpot C_F_DblLeftAndRightEdgesTourist_Kink C_F_DblLeftAndRightEdgesTourist_LB C_F_DblLeftAndRightEdgesTourist_PixelHB C_F_DblLeftAndRightEdgesTourist_PixelKink C_F_DblLeftAndRightEdgesTown_HBSpot C_F_DblLeftAndRightEdgesTown_Kink C_F_DblLeftAndRightEdgesTown_LB C_F_DblLeftAndRightEdgesTown_PixelHB C_F_DblLeftAndRightEdgesTown_PixelKink C_GeneralDrvHystresis C_GeneralDrvTemp_Threshold C_LedDeratingStep C_LedFeature_On C_LedHighTemp C_LedHystValue C_LedLowTemp C_LedPWMMins C_LedPWMNominals C_LedResTable1 C_LedResTable10 C_LedResTable11 C_LedResTable12 C_LedResTable13 C_LedResTable14 C_LedResTable15 C_LedResTable16 C_LedResTable17 C_LedResTable18 C_LedResTable19 C_LedResTable2 C_LedResTable20 C_LedResTable21 C_LedResTable22 C_LedResTable23 C_LedResTable24 C_LedResTable25 C_LedResTable26 C_LedResTable3 C_LedResTable4 C_LedResTable5 C_LedResTable6 C_LedResTable7 C_LedResTable8 C_LedResTable9 C_LedTempChannelConfig C_LedTempTable C_LedTempThreshold PAR_BAV_DecreaseSmoothness PAR_BAV_VMax PAR_BAV_VMin PAR_BinDCDCBinSensorChannel PAR_BinSavedCurrentDCDC1 PAR_BinSavedCurrentDCDC10 PAR_BinSavedCurrentDCDC11 PAR_BinSavedCurrentDCDC12 PAR_BinSavedCurrentDCDC2 PAR_BinSavedCurrentDCDC3 PAR_BinSavedCurrentDCDC4 PAR_BinSavedCurrentDCDC5 PAR_BinSavedCurrentDCDC6 PAR_BinSavedCurrentDCDC7 PAR_BinSavedCurrentDCDC8 PAR_BinSavedCurrentDCDC9 PAR_BinSavedDcyDCDC1 PAR_BinSavedDcyDCDC10 PAR_BinSavedDcyDCDC11 PAR_BinSavedDcyDCDC12 PAR_BinSavedDcyDCDC2 PAR_BinSavedDcyDCDC3 PAR_BinSavedDcyDCDC4 PAR_BinSavedDcyDCDC5 PAR_BinSavedDcyDCDC6 PAR_BinSavedDcyDCDC7 PAR_BinSavedDcyDCDC8 PAR_BinSavedDcyDCDC9 PAR_BinTableSensor1 PAR_BinTableSensorTPS PAR_BoostEfficiencyEfficiency PAR_BoostEfficiencyVoltage PAR_DCDCDefaultVoltageValue PAR_DCDCEfficiencies PAR_DCDCPWMThermalDerating PAR_DCDCPwrDeratingMin PAR_DigPderatingDecGain PAR_DigPderatingFilterAvailCoeff PAR_DigPderatingFilterNeedsCoeff PAR_DigPderatingIncGain PAR_LEDOUTisPostSwitched PAR_MaxCurrentAuxSupply PAR_MaxCurrentKL30 PAR_NbrTickMaxVoltage PAR_PowerDeratingHyst PAR_PwrPowDeratingMaxPwrLUT PAR_PwrPowDeratingMaxVoltLUT PAR_Pwr_Needed_init PAR_VHeadRoom P_EndValue P_FALM_DetectedStateValue P_FALM_FANOVDevalThreshold P_FALM_FANOVThreshold P_FALM_FANUVDevalThreshold P_FALM_FANUVThreshold P_FALM_LEDOCDevalThreshold P_FALM_LEDOCThreshold P_FALM_LEDOVDevalThreshold P_FALM_LEDOVThreshold P_FALM_LEDSCDevalThreshold P_FALM_LEDSCThreshold P_FALM_LEDSCneeds P_FALM_LEDUVDevalThreshold P_FALM_LEDUVThreshold P_FALM_LVLDBLOVDevalThreshold P_FALM_LVLDBLOVThreshold P_FALM_LVLDBLUVDevalThreshold P_FALM_LVLDBLUVThreshold P_FALM_UnDetectedStateValue P_StartValue P_TRamp P_TStart /end REF_CHARACTERISTIC
 /begin SUB_GROUP C_DrvDeratingStep C_DrvHystresis C_DrvNominalPWM C_DrvPWMMins C_DrvTemp_Threshold C_GeneralDrvTemp_Threshold PAR_BinSavedCurrentDCDC PAR_BinSavedDcyDCDC PAR_BoostEfficiencyEfficiency PAR_DCDCEfficiencies PAR_DCDCPwrDeratingMin PAR_LEDOUTisPostSwitched PAR_PwrPowDeratingMaxVoltLUT /end SUB_GROUP
/end GROUP
/begin GROUP PAR_BinSavedCurrentDCDC ""
 /begin REF_CHARACTERISTIC NvM_BinSavedCurrentDCDC10_ROM NvM_BinSavedCurrentDCDC11_ROM NvM_BinSavedCurrentDCDC12_ROM NvM_BinSavedCurrentDCDC1_ROM NvM_BinSavedCurrentDCDC2_ROM NvM_BinSavedCurrentDCDC3_ROM NvM_BinSavedCurrentDCDC4_ROM NvM_BinSavedCurrentDCDC5_ROM NvM_BinSavedCurrentDCDC6_ROM NvM_BinSavedCurrentDCDC7_ROM NvM_BinSavedCurrentDCDC8_ROM NvM_BinSavedCurrentDCDC9_ROM /end REF_CHARACTERISTIC
/end GROUP
/begin GROUP PAR_BinSavedDcyDCDC ""
 /begin REF_CHARACTERISTIC NvM_BinSavedDcyDCDC10_ROM NvM_BinSavedDcyDCDC11_ROM NvM_BinSavedDcyDCDC12_ROM NvM_BinSavedDcyDCDC1_ROM NvM_BinSavedDcyDCDC2_ROM NvM_BinSavedDcyDCDC3_ROM NvM_BinSavedDcyDCDC4_ROM NvM_BinSavedDcyDCDC5_ROM NvM_BinSavedDcyDCDC6_ROM NvM_BinSavedDcyDCDC7_ROM NvM_BinSavedDcyDCDC8_ROM NvM_BinSavedDcyDCDC9_ROM /end REF_CHARACTERISTIC
/end GROUP
/begin GROUP PAR_BoostEfficiencyEfficiency "" /begin REF_CHARACTERISTIC ku16PwrBoostEfficiencyEfficiency /end REF_CHARACTERISTIC /end GROUP
/begin GROUP PAR_DCDCEfficiencies "" /begin REF_CHARACTERISTIC ku8PwrDCDCEfficiencies /end REF_CHARACTERISTIC /end GROUP
/begin GROUP PAR_DCDCPwrDeratingMin "minimum ratio for power derating" /begin REF_CHARACTERISTIC ku16PwrDCDCPwrDeratingMin /end REF_CHARACTERISTIC /end GROUP
/begin GROUP PAR_DigPhaseSwitch_X_TPS_Y "" /begin SUB_GROUP TPS1 TPS2 TPS3 TPS4 TPS5 TPS6 TPS7 TPS8 /end SUB_GROUP /end GROUP
/begin GROUP PAR_InitialDutyCycle "Init duty cycles (0 for 0%, HTPS_u16MAX_DUTY for 100%) for Switches" /begin REF_CHARACTERISTIC au16InitialDutyCycle /end REF_CHARACTERISTIC /end GROUP
/begin GROUP PAR_LEDOUTisPostSwitched "Give the information if the LED string connected is associated with a switching deice like TPS" /begin REF_CHARACTERISTIC ku8PwrLedOutTisPostSwitched /end REF_CHARACTERISTIC /end GROUP
/begin GROUP PAR_PwrPowDeratingMaxVoltLUT "voltage value for pwr available LUT" /begin REF_CHARACTERISTIC ku16PwrPowDeratingMaxVoltLUT /end REF_CHARACTERISTIC /end GROUP
/begin GROUP PowerSwitch "" ROOT
 /begin REF_CHARACTERISTIC ACFG_ku8SupVsatOptionalCmdConsidered_ROM ASWM_enuSwitch5ActivationState ASWM_u8BoolSwitchNeeded1Config ASWM_u8BoolSwitchNeeded2Config ASWM_u8BoolSwitchNeeded3Config ASWM_u8BoolSwitchNeeded4Config ASWM_u8BoolSwitchNeeded5Config PAR_OverCurrentThershold PAR_UnderCurrentThershold s32DefSmartCh1Ch2OverTemp s32DefSmartCh1Ch2VccOvervoltage s32DefSmartCh1Ch2VccUndervoltage s32DefSmartCh3Ch4OverTemp s32DefSmartCh3Ch4VccOvervoltage s32DefSmartCh3Ch4VccUndervoltage /end REF_CHARACTERISTIC
/end GROUP
/begin GROUP Preprocessing "" ROOT
 /begin REF_CHARACTERISTIC C_AccFiltCoeff C_AngleScaleCoeff C_DirectionTransmissionFactor C_FiltStWhAngCoeff C_FiltStWhAngSpdCoeff C_Te_PPR C_VehSpdCoeff C_VspeedWfyaw C_Wfyaw C_WheelAxleDistance /end REF_CHARACTERISTIC
/end GROUP
/begin GROUP TPS1 "" /begin REF_CHARACTERISTIC au16PhaseInit_TPS1 /end REF_CHARACTERISTIC /end GROUP
/begin GROUP TPS2 "" /begin REF_CHARACTERISTIC au16PhaseInit_TPS2 /end REF_CHARACTERISTIC /end GROUP
/begin GROUP TPS3 "" /begin REF_CHARACTERISTIC au16PhaseInit_TPS3 /end REF_CHARACTERISTIC /end GROUP
/begin GROUP TPS4 "" /begin REF_CHARACTERISTIC au16PhaseInit_TPS4 /end REF_CHARACTERISTIC /end GROUP
/begin GROUP TPS5 "" /begin REF_CHARACTERISTIC au16PhaseInit_TPS5 /end REF_CHARACTERISTIC /end GROUP
/begin GROUP TPS6 "" /begin REF_CHARACTERISTIC au16PhaseInit_TPS6 /end REF_CHARACTERISTIC /end GROUP
/begin GROUP TPS7 "" /begin REF_CHARACTERISTIC au16PhaseInit_TPS7 /end REF_CHARACTERISTIC /end GROUP
/begin GROUP TPS8 "" /begin REF_CHARACTERISTIC au16PhaseInit_TPS8 /end REF_CHARACTERISTIC /end GROUP
/begin GROUP astrLedTpsMapping_FullLeds ""
 /begin REF_CHARACTERISTIC astrLedTpsMapping_FullLeds._0_.enuLedNB astrLedTpsMapping_FullLeds._0_.enuSwNB astrLedTpsMapping_FullLeds._0_.enuTpsID astrLedTpsMapping_FullLeds._10_.enuLedNB astrLedTpsMapping_FullLeds._10_.enuSwNB astrLedTpsMapping_FullLeds._10_.enuTpsID astrLedTpsMapping_FullLeds._11_.enuLedNB astrLedTpsMapping_FullLeds._11_.enuSwNB astrLedTpsMapping_FullLeds._11_.enuTpsID astrLedTpsMapping_FullLeds._12_.enuLedNB astrLedTpsMapping_FullLeds._12_.enuSwNB astrLedTpsMapping_FullLeds._12_.enuTpsID astrLedTpsMapping_FullLeds._13_.enuLedNB astrLedTpsMapping_FullLeds._13_.enuSwNB astrLedTpsMapping_FullLeds._13_.enuTpsID astrLedTpsMapping_FullLeds._14_.enuLedNB astrLedTpsMapping_FullLeds._14_.enuSwNB astrLedTpsMapping_FullLeds._14_.enuTpsID astrLedTpsMapping_FullLeds._15_.enuLedNB astrLedTpsMapping_FullLeds._15_.enuSwNB astrLedTpsMapping_FullLeds._15_.enuTpsID astrLedTpsMapping_FullLeds._16_.enuLedNB astrLedTpsMapping_FullLeds._16_.enuSwNB astrLedTpsMapping_FullLeds._16_.enuTpsID astrLedTpsMapping_FullLeds._17_.enuLedNB astrLedTpsMapping_FullLeds._17_.enuSwNB astrLedTpsMapping_FullLeds._17_.enuTpsID astrLedTpsMapping_FullLeds._18_.enuLedNB astrLedTpsMapping_FullLeds._18_.enuSwNB astrLedTpsMapping_FullLeds._18_.enuTpsID astrLedTpsMapping_FullLeds._19_.enuLedNB astrLedTpsMapping_FullLeds._19_.enuSwNB astrLedTpsMapping_FullLeds._19_.enuTpsID astrLedTpsMapping_FullLeds._1_.enuLedNB astrLedTpsMapping_FullLeds._1_.enuSwNB astrLedTpsMapping_FullLeds._1_.enuTpsID astrLedTpsMapping_FullLeds._20_.enuLedNB astrLedTpsMapping_FullLeds._20_.enuSwNB astrLedTpsMapping_FullLeds._20_.enuTpsID astrLedTpsMapping_FullLeds._21_.enuLedNB astrLedTpsMapping_FullLeds._21_.enuSwNB astrLedTpsMapping_FullLeds._21_.enuTpsID astrLedTpsMapping_FullLeds._22_.enuLedNB astrLedTpsMapping_FullLeds._22_.enuSwNB astrLedTpsMapping_FullLeds._22_.enuTpsID astrLedTpsMapping_FullLeds._23_.enuLedNB astrLedTpsMapping_FullLeds._23_.enuSwNB astrLedTpsMapping_FullLeds._23_.enuTpsID astrLedTpsMapping_FullLeds._24_.enuLedNB astrLedTpsMapping_FullLeds._24_.enuSwNB astrLedTpsMapping_FullLeds._24_.enuTpsID astrLedTpsMapping_FullLeds._25_.enuLedNB astrLedTpsMapping_FullLeds._25_.enuSwNB astrLedTpsMapping_FullLeds._25_.enuTpsID astrLedTpsMapping_FullLeds._26_.enuLedNB astrLedTpsMapping_FullLeds._26_.enuSwNB astrLedTpsMapping_FullLeds._26_.enuTpsID astrLedTpsMapping_FullLeds._27_.enuLedNB astrLedTpsMapping_FullLeds._27_.enuSwNB astrLedTpsMapping_FullLeds._27_.enuTpsID astrLedTpsMapping_FullLeds._28_.enuLedNB astrLedTpsMapping_FullLeds._28_.enuSwNB astrLedTpsMapping_FullLeds._28_.enuTpsID astrLedTpsMapping_FullLeds._29_.enuLedNB astrLedTpsMapping_FullLeds._29_.enuSwNB astrLedTpsMapping_FullLeds._29_.enuTpsID astrLedTpsMapping_FullLeds._2_.enuLedNB astrLedTpsMapping_FullLeds._2_.enuSwNB astrLedTpsMapping_FullLeds._2_.enuTpsID astrLedTpsMapping_FullLeds._30_.enuLedNB astrLedTpsMapping_FullLeds._30_.enuSwNB astrLedTpsMapping_FullLeds._30_.enuTpsID astrLedTpsMapping_FullLeds._31_.enuLedNB astrLedTpsMapping_FullLeds._31_.enuSwNB astrLedTpsMapping_FullLeds._31_.enuTpsID astrLedTpsMapping_FullLeds._32_.enuLedNB astrLedTpsMapping_FullLeds._32_.enuSwNB astrLedTpsMapping_FullLeds._32_.enuTpsID astrLedTpsMapping_FullLeds._33_.enuLedNB astrLedTpsMapping_FullLeds._33_.enuSwNB astrLedTpsMapping_FullLeds._33_.enuTpsID astrLedTpsMapping_FullLeds._34_.enuLedNB astrLedTpsMapping_FullLeds._34_.enuSwNB astrLedTpsMapping_FullLeds._34_.enuTpsID astrLedTpsMapping_FullLeds._35_.enuLedNB astrLedTpsMapping_FullLeds._35_.enuSwNB astrLedTpsMapping_FullLeds._35_.enuTpsID astrLedTpsMapping_FullLeds._36_.enuLedNB astrLedTpsMapping_FullLeds._36_.enuSwNB astrLedTpsMapping_FullLeds._36_.enuTpsID astrLedTpsMapping_FullLeds._37_.enuLedNB astrLedTpsMapping_FullLeds._37_.enuSwNB astrLedTpsMapping_FullLeds._37_.enuTpsID astrLedTpsMapping_FullLeds._38_.enuLedNB astrLedTpsMapping_FullLeds._38_.enuSwNB astrLedTpsMapping_FullLeds._38_.enuTpsID astrLedTpsMapping_FullLeds._39_.enuLedNB astrLedTpsMapping_FullLeds._39_.enuSwNB astrLedTpsMapping_FullLeds._39_.enuTpsID astrLedTpsMapping_FullLeds._3_.enuLedNB astrLedTpsMapping_FullLeds._3_.enuSwNB astrLedTpsMapping_FullLeds._3_.enuTpsID astrLedTpsMapping_FullLeds._40_.enuLedNB astrLedTpsMapping_FullLeds._40_.enuSwNB astrLedTpsMapping_FullLeds._40_.enuTpsID astrLedTpsMapping_FullLeds._41_.enuLedNB astrLedTpsMapping_FullLeds._41_.enuSwNB astrLedTpsMapping_FullLeds._41_.enuTpsID astrLedTpsMapping_FullLeds._42_.enuLedNB astrLedTpsMapping_FullLeds._42_.enuSwNB astrLedTpsMapping_FullLeds._42_.enuTpsID astrLedTpsMapping_FullLeds._43_.enuLedNB astrLedTpsMapping_FullLeds._43_.enuSwNB astrLedTpsMapping_FullLeds._43_.enuTpsID astrLedTpsMapping_FullLeds._44_.enuLedNB astrLedTpsMapping_FullLeds._44_.enuSwNB astrLedTpsMapping_FullLeds._44_.enuTpsID astrLedTpsMapping_FullLeds._45_.enuLedNB astrLedTpsMapping_FullLeds._45_.enuSwNB astrLedTpsMapping_FullLeds._45_.enuTpsID astrLedTpsMapping_FullLeds._46_.enuLedNB astrLedTpsMapping_FullLeds._46_.enuSwNB astrLedTpsMapping_FullLeds._46_.enuTpsID astrLedTpsMapping_FullLeds._47_.enuLedNB astrLedTpsMapping_FullLeds._47_.enuSwNB astrLedTpsMapping_FullLeds._47_.enuTpsID astrLedTpsMapping_FullLeds._48_.enuLedNB astrLedTpsMapping_FullLeds._48_.enuSwNB astrLedTpsMapping_FullLeds._48_.enuTpsID astrLedTpsMapping_FullLeds._49_.enuLedNB astrLedTpsMapping_FullLeds._49_.enuSwNB astrLedTpsMapping_FullLeds._49_.enuTpsID astrLedTpsMapping_FullLeds._4_.enuLedNB astrLedTpsMapping_FullLeds._4_.enuSwNB astrLedTpsMapping_FullLeds._4_.enuTpsID astrLedTpsMapping_FullLeds._50_.enuLedNB astrLedTpsMapping_FullLeds._50_.enuSwNB astrLedTpsMapping_FullLeds._50_.enuTpsID astrLedTpsMapping_FullLeds._51_.enuLedNB astrLedTpsMapping_FullLeds._51_.enuSwNB astrLedTpsMapping_FullLeds._51_.enuTpsID astrLedTpsMapping_FullLeds._52_.enuLedNB astrLedTpsMapping_FullLeds._52_.enuSwNB astrLedTpsMapping_FullLeds._52_.enuTpsID astrLedTpsMapping_FullLeds._53_.enuLedNB astrLedTpsMapping_FullLeds._53_.enuSwNB astrLedTpsMapping_FullLeds._53_.enuTpsID astrLedTpsMapping_FullLeds._54_.enuLedNB astrLedTpsMapping_FullLeds._54_.enuSwNB astrLedTpsMapping_FullLeds._54_.enuTpsID astrLedTpsMapping_FullLeds._55_.enuLedNB astrLedTpsMapping_FullLeds._55_.enuSwNB astrLedTpsMapping_FullLeds._55_.enuTpsID astrLedTpsMapping_FullLeds._56_.enuLedNB astrLedTpsMapping_FullLeds._56_.enuSwNB astrLedTpsMapping_FullLeds._56_.enuTpsID astrLedTpsMapping_FullLeds._57_.enuLedNB astrLedTpsMapping_FullLeds._57_.enuSwNB astrLedTpsMapping_FullLeds._57_.enuTpsID astrLedTpsMapping_FullLeds._58_.enuLedNB astrLedTpsMapping_FullLeds._58_.enuSwNB astrLedTpsMapping_FullLeds._58_.enuTpsID astrLedTpsMapping_FullLeds._59_.enuLedNB astrLedTpsMapping_FullLeds._59_.enuSwNB astrLedTpsMapping_FullLeds._59_.enuTpsID astrLedTpsMapping_FullLeds._5_.enuLedNB astrLedTpsMapping_FullLeds._5_.enuSwNB astrLedTpsMapping_FullLeds._5_.enuTpsID astrLedTpsMapping_FullLeds._60_.enuLedNB astrLedTpsMapping_FullLeds._60_.enuSwNB astrLedTpsMapping_FullLeds._60_.enuTpsID astrLedTpsMapping_FullLeds._61_.enuLedNB astrLedTpsMapping_FullLeds._61_.enuSwNB astrLedTpsMapping_FullLeds._61_.enuTpsID astrLedTpsMapping_FullLeds._62_.enuLedNB astrLedTpsMapping_FullLeds._62_.enuSwNB astrLedTpsMapping_FullLeds._62_.enuTpsID astrLedTpsMapping_FullLeds._63_.enuLedNB astrLedTpsMapping_FullLeds._63_.enuSwNB astrLedTpsMapping_FullLeds._63_.enuTpsID astrLedTpsMapping_FullLeds._64_.enuLedNB astrLedTpsMapping_FullLeds._64_.enuSwNB astrLedTpsMapping_FullLeds._64_.enuTpsID astrLedTpsMapping_FullLeds._65_.enuLedNB astrLedTpsMapping_FullLeds._65_.enuSwNB astrLedTpsMapping_FullLeds._65_.enuTpsID astrLedTpsMapping_FullLeds._66_.enuLedNB astrLedTpsMapping_FullLeds._66_.enuSwNB astrLedTpsMapping_FullLeds._66_.enuTpsID astrLedTpsMapping_FullLeds._67_.enuLedNB astrLedTpsMapping_FullLeds._67_.enuSwNB astrLedTpsMapping_FullLeds._67_.enuTpsID astrLedTpsMapping_FullLeds._68_.enuLedNB astrLedTpsMapping_FullLeds._68_.enuSwNB astrLedTpsMapping_FullLeds._68_.enuTpsID astrLedTpsMapping_FullLeds._69_.enuLedNB astrLedTpsMapping_FullLeds._69_.enuSwNB astrLedTpsMapping_FullLeds._69_.enuTpsID astrLedTpsMapping_FullLeds._6_.enuLedNB astrLedTpsMapping_FullLeds._6_.enuSwNB astrLedTpsMapping_FullLeds._6_.enuTpsID astrLedTpsMapping_FullLeds._70_.enuLedNB astrLedTpsMapping_FullLeds._70_.enuSwNB astrLedTpsMapping_FullLeds._70_.enuTpsID astrLedTpsMapping_FullLeds._71_.enuLedNB astrLedTpsMapping_FullLeds._71_.enuSwNB astrLedTpsMapping_FullLeds._71_.enuTpsID astrLedTpsMapping_FullLeds._72_.enuLedNB astrLedTpsMapping_FullLeds._72_.enuSwNB astrLedTpsMapping_FullLeds._72_.enuTpsID astrLedTpsMapping_FullLeds._73_.enuLedNB astrLedTpsMapping_FullLeds._73_.enuSwNB astrLedTpsMapping_FullLeds._73_.enuTpsID astrLedTpsMapping_FullLeds._74_.enuLedNB astrLedTpsMapping_FullLeds._74_.enuSwNB astrLedTpsMapping_FullLeds._74_.enuTpsID astrLedTpsMapping_FullLeds._75_.enuLedNB astrLedTpsMapping_FullLeds._75_.enuSwNB astrLedTpsMapping_FullLeds._75_.enuTpsID astrLedTpsMapping_FullLeds._76_.enuLedNB astrLedTpsMapping_FullLeds._76_.enuSwNB astrLedTpsMapping_FullLeds._76_.enuTpsID astrLedTpsMapping_FullLeds._77_.enuLedNB astrLedTpsMapping_FullLeds._77_.enuSwNB astrLedTpsMapping_FullLeds._77_.enuTpsID astrLedTpsMapping_FullLeds._78_.enuLedNB astrLedTpsMapping_FullLeds._78_.enuSwNB astrLedTpsMapping_FullLeds._78_.enuTpsID astrLedTpsMapping_FullLeds._79_.enuLedNB astrLedTpsMapping_FullLeds._79_.enuSwNB astrLedTpsMapping_FullLeds._79_.enuTpsID astrLedTpsMapping_FullLeds._7_.enuLedNB astrLedTpsMapping_FullLeds._7_.enuSwNB astrLedTpsMapping_FullLeds._7_.enuTpsID astrLedTpsMapping_FullLeds._80_.enuLedNB astrLedTpsMapping_FullLeds._80_.enuSwNB astrLedTpsMapping_FullLeds._80_.enuTpsID astrLedTpsMapping_FullLeds._81_.enuLedNB astrLedTpsMapping_FullLeds._81_.enuSwNB astrLedTpsMapping_FullLeds._81_.enuTpsID astrLedTpsMapping_FullLeds._82_.enuLedNB astrLedTpsMapping_FullLeds._82_.enuSwNB astrLedTpsMapping_FullLeds._82_.enuTpsID astrLedTpsMapping_FullLeds._83_.enuLedNB astrLedTpsMapping_FullLeds._83_.enuSwNB astrLedTpsMapping_FullLeds._83_.enuTpsID astrLedTpsMapping_FullLeds._84_.enuLedNB astrLedTpsMapping_FullLeds._84_.enuSwNB astrLedTpsMapping_FullLeds._84_.enuTpsID astrLedTpsMapping_FullLeds._85_.enuLedNB astrLedTpsMapping_FullLeds._85_.enuSwNB astrLedTpsMapping_FullLeds._85_.enuTpsID astrLedTpsMapping_FullLeds._86_.enuLedNB astrLedTpsMapping_FullLeds._86_.enuSwNB astrLedTpsMapping_FullLeds._86_.enuTpsID astrLedTpsMapping_FullLeds._87_.enuLedNB astrLedTpsMapping_FullLeds._87_.enuSwNB astrLedTpsMapping_FullLeds._87_.enuTpsID astrLedTpsMapping_FullLeds._88_.enuLedNB astrLedTpsMapping_FullLeds._88_.enuSwNB astrLedTpsMapping_FullLeds._88_.enuTpsID astrLedTpsMapping_FullLeds._89_.enuLedNB astrLedTpsMapping_FullLeds._89_.enuSwNB astrLedTpsMapping_FullLeds._89_.enuTpsID astrLedTpsMapping_FullLeds._8_.enuLedNB astrLedTpsMapping_FullLeds._8_.enuSwNB astrLedTpsMapping_FullLeds._8_.enuTpsID astrLedTpsMapping_FullLeds._90_.enuLedNB astrLedTpsMapping_FullLeds._90_.enuSwNB astrLedTpsMapping_FullLeds._90_.enuTpsID astrLedTpsMapping_FullLeds._91_.enuLedNB astrLedTpsMapping_FullLeds._91_.enuSwNB astrLedTpsMapping_FullLeds._91_.enuTpsID astrLedTpsMapping_FullLeds._92_.enuLedNB astrLedTpsMapping_FullLeds._92_.enuSwNB astrLedTpsMapping_FullLeds._92_.enuTpsID astrLedTpsMapping_FullLeds._93_.enuLedNB astrLedTpsMapping_FullLeds._93_.enuSwNB astrLedTpsMapping_FullLeds._93_.enuTpsID astrLedTpsMapping_FullLeds._94_.enuLedNB astrLedTpsMapping_FullLeds._94_.enuSwNB astrLedTpsMapping_FullLeds._94_.enuTpsID astrLedTpsMapping_FullLeds._95_.enuLedNB astrLedTpsMapping_FullLeds._95_.enuSwNB astrLedTpsMapping_FullLeds._95_.enuTpsID astrLedTpsMapping_FullLeds._9_.enuLedNB astrLedTpsMapping_FullLeds._9_.enuSwNB astrLedTpsMapping_FullLeds._9_.enuTpsID /end REF_CHARACTERISTIC
/end GROUP
/end MODULE
/end PROJECT
